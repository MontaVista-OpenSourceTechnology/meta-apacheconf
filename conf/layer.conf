## conf/layer.conf
```bitbake
BBPATH .= ":${LAYERDIR}"

BBFILES += "${LAYERDIR}/recipes-*/*/*.bb \
            ${LAYERDIR}/recipes-*/*/*.bbappend"

BBFILE_COLLECTIONS += "apacheconf"
BBFILE_PATTERN_apacheconf = "^${LAYERDIR}/"
BBFILE_PRIORITY_apacheconf = "5"
LAYERVERSION_apacheconf = "1"
LAYERSERIES_COMPAT_apacheconf = "kirkstone"

LAYERDEPENDS_apacheconf = " \
    selinux \
"
```
